## ascot-esp32c3/sdkconfig.defaults
```kconfig
# Stack size used by the board. If there are some stack blowups, increase this
value until there are no more issue.
CONFIG_ESP_MAIN_TASK_STACK_SIZE=90000
# Stack size associated to system event
CONFIG_ESP_SYSTEM_EVENT_TASK_STACK_SIZE=4096
# Default stack size associated to each thread
CONFIG_PTHREAD_TASK_STACK_SIZE_DEFAULT=8192
```
